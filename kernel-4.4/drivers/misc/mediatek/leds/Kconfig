## kernel-4.4/drivers/misc/mediatek/leds/Kconfig
```kconfig
config MTK_LEDS
	tristate "MediaTek LED Support"
	depends on LEDS_CLASS
	---help---
	  This selects the MediaTek(R) LEDs connected to MediaTek chips.
	  If you want to use MediaTek(R) LEDs support, say Y or M here.
	  If unsure, say N.
	  Mediatek LED module includes backlight, indicate LED, keypad LED, button LED etc.

config LIGHTNESS_MAPPING_VALUE
	int "Backlight brightness mapping value"
	default 255
	---help---
	  Backlight brightness mapping value, from 0 to 255.

config BACKLIGHT_SUPPORT_LP8557
	bool "Support backlight lp8557 board"
	default n
	---help---
	  LED driver for LP8557 support.
	  Set y to support.
	  Set n to disable.
	  For pwm external backlight.

config BACKLIGHT_SUPPORT_LM3697
	bool "LM3697(DW8832) Support"
	default n
	---help---
	  LED driver for lm3697(dw8832) support.
	  Set y to support.
	  Set n to disable.
	  Charge pump driver for external backlight.

config LGE_USE_BRIGHTNESS_TABLE
	bool "LGE brightness table Support"
	default n
	---help---
	  LED driver for LGE brightness table Support.

config LGE_LEDS_DEFAULT_STEP_ISINK0
	int "LG Electronics LED Indicator default sink current for channel 0"
	default 3
	range 0 5
	depends on MTK_PMIC_CHIP_MT6356 && MTK_LEDS && LGE_LEDS
	help
	  0 = 2mA, 1 =  4mA, 2 =  6mA, 3 = 8mA, 4 = 10mA, 5 = 12mA

config LGE_LEDS_DEFAULT_STEP_ISINK1
	int "LG Electronics LED Indicator default sink current for channel 1"
	default 3
	range 0 5
	depends on MTK_LEDS && LGE_LEDS
	help
	  0 = 2mA, 1 =  4mA, 2 =  6mA, 3 = 8mA, 4 = 10mA, 5 = 12mA
```
